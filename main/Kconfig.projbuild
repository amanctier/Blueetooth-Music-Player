## main/Kconfig.projbuild
```kconfig
menu "A2DP Example Configuration"
    config EXAMPLE_SSP_ENABLED
        bool "Secure Simple Pairing"
        depends on BT_CLASSIC_ENABLED
        default y
        help
            This enables the Secure Simple Pairing. If disable this option,
            Bluedroid will only support Legacy Pairing

    config EXAMPLE_PEER_DEVICE_NAME
        string "Target Device Name"
        default "Mujib's Buds2 Pro #2"
        help
            Use this option to set target device name to connect.
endmenu
```
